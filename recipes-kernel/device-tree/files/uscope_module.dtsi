/ {
    uScope@fffc0000 {
        compatible = "ucube_lkm";
        reg = <0xfffc0000 0x8000>;
        interrupts = <0x00 0x1d 0x01>;
        clocks = <&clkc 15>, <&clkc 16>, <&clkc 17>, <&clkc 18>;
        clock-names = "fclk0", "fclk1", "fclk2", "fclk3";
        interrupt-parent = <0x04>;
    };
};
